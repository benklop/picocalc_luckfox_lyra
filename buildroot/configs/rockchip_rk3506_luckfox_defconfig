## buildroot/configs/rockchip_rk3506_luckfox_defconfig
```kconfig
#include "base/base.config"
#include "fs/vfat.config"
#include "multimedia/audio.config"
#include "lvgl/lvgl_rkadk.config"
#include "fs/ubifs.config"
BR2_EXTRA_TARGET_GCC_CONFIG_OPTIONS="--enable-languages=c,c++"
BR2_GENERATE_LOCALE="en_US.UTF-8"
BR2_PACKAGE_AERC=y
BR2_PACKAGE_CAN_UTILS=y
BR2_PACKAGE_CA_CERTIFICATES=y
BR2_PACKAGE_CMAKE_CTEST=y
BR2_PACKAGE_CMATRIX=y
BR2_PACKAGE_COREUTILS=y
BR2_PACKAGE_DBUS_CPP=y
BR2_PACKAGE_DBUS_GLIB=y
BR2_PACKAGE_DBUS_TRIGGERD=y
BR2_PACKAGE_DIRECTFB=y
BR2_PACKAGE_DNSMASQ=y
BR2_PACKAGE_DOOM_WAD=y
BR2_PACKAGE_DOSBOX=y
BR2_PACKAGE_EVTEST=y
BR2_PACKAGE_EXTRA_CMAKE_MODULES=y
BR2_PACKAGE_F2FS_TOOLS=y
BR2_PACKAGE_FBSET=y
BR2_PACKAGE_FBTERM=y
BR2_PACKAGE_FCITX=y
BR2_PACKAGE_FCITX_FBTERM=y
BR2_PACKAGE_FILE=y
BR2_PACKAGE_FINDUTILS=y
BR2_PACKAGE_GAWK=y
BR2_PACKAGE_GCC_TARGET=y
BR2_PACKAGE_GETTEXT=y
BR2_PACKAGE_GIT=y
BR2_PACKAGE_GLIBC_UTILS=y
BR2_PACKAGE_GPTFDISK=y
BR2_PACKAGE_GPTFDISK_GDISK=y
BR2_PACKAGE_GPTFDISK_SGDISK=y
BR2_PACKAGE_GREP=y
BR2_PACKAGE_HOSTAPD=y
BR2_PACKAGE_HOST_LINUX_HEADERS_CUSTOM_6_1=y
BR2_PACKAGE_HOST_OPKG_UTILS=y
BR2_PACKAGE_HOST_ZSTD=y
BR2_PACKAGE_HTOP=y
BR2_PACKAGE_HTPDATE=y
BR2_PACKAGE_IMLIB2_ID3=y
BR2_PACKAGE_IMLIB2_TIFF=y
BR2_PACKAGE_IPERF3=y
BR2_PACKAGE_IPROUTE2=y
BR2_PACKAGE_IW=y
BR2_PACKAGE_JQ=y
BR2_PACKAGE_KBD=y
BR2_PACKAGE_LIBCAP=y
BR2_PACKAGE_LIBCURL_CURL=y
BR2_PACKAGE_LIBEVDEV=y
BR2_PACKAGE_LIBJPEG=y
BR2_PACKAGE_LIBOLM=y
BR2_PACKAGE_LIBOPENSSL_BIN=y
BR2_PACKAGE_LIBRETRO_BSNES=y
BR2_PACKAGE_LIBRETRO_BSNES_BALANCED=y
BR2_PACKAGE_LIBRETRO_FCEUNEXT=y
BR2_PACKAGE_LIBRETRO_GEARBOY=y
BR2_PACKAGE_LIBRETRO_MGBA=y
BR2_PACKAGE_LIBTOOL=y
BR2_PACKAGE_LIBXKBCOMMON=y
BR2_PACKAGE_LRZSZ=y
BR2_PACKAGE_LUA=y
BR2_PACKAGE_LUA_READLINE=y
# BR2_PACKAGE_LVGL is reset to default
BR2_PACKAGE_LYNX=y
BR2_PACKAGE_MAKE=y
BR2_PACKAGE_MHZ=y
BR2_PACKAGE_MINICOM=y
BR2_PACKAGE_MOSH=y
BR2_PACKAGE_NANO=y
BR2_PACKAGE_NCFTP=y
BR2_PACKAGE_NCURSES_TARGET_PROGS=y
BR2_PACKAGE_NCURSES_WCHAR=y
BR2_PACKAGE_NETCAT=y
BR2_PACKAGE_NET_TOOLS=y
BR2_PACKAGE_NMAP=y
BR2_PACKAGE_NMAP_NCAT=y
BR2_PACKAGE_NMAP_NMAP=y
BR2_PACKAGE_NMAP_NPING=y
BR2_PACKAGE_NTP=y
BR2_PACKAGE_NTP_NTPDATE=y
BR2_PACKAGE_OPENSSH_GEN_KEYS=y
BR2_PACKAGE_OPKG=y
BR2_PACKAGE_OPKG_UTILS=y
BR2_PACKAGE_PERL=y
BR2_PACKAGE_PHYTOOL=y
BR2_PACKAGE_PKGCONF=y
BR2_PACKAGE_PPPD=y
BR2_PACKAGE_PRBOOM=y
BR2_PACKAGE_PROCPS_NG=y
# BR2_PACKAGE_PULSEAUDIO is reset to default
BR2_PACKAGE_PYTHON3_CURSES=y
BR2_PACKAGE_PYTHON3_DECIMAL=y
BR2_PACKAGE_PYTHON3_READLINE=y
BR2_PACKAGE_PYTHON_AIOHTTP=y
BR2_PACKAGE_PYTHON_CANOPEN=y
BR2_PACKAGE_PYTHON_CLICK=y
BR2_PACKAGE_PYTHON_ITSDANGEROUS=y
BR2_PACKAGE_PYTHON_JINJA2=y
BR2_PACKAGE_PYTHON_PERIPHERY=y
BR2_PACKAGE_PYTHON_PILLOW=y
BR2_PACKAGE_PYTHON_PIP=y
BR2_PACKAGE_PYTHON_SCIPY=y
BR2_PACKAGE_PYTHON_SERIAL=y
BR2_PACKAGE_PYTHON_SMBUS_CFFI=y
BR2_PACKAGE_PYTHON_SPIDEV=y
BR2_PACKAGE_PYTHON_SYMPY=y
BR2_PACKAGE_PYTHON_WERKZEUG=y
BR2_PACKAGE_RETROARCH=y
BR2_PACKAGE_RIPGREP=y
BR2_PACKAGE_RK3506=y
BR2_PACKAGE_RKADK=y
BR2_PACKAGE_RKADK_DISPLAY=y
BR2_PACKAGE_RKADK_EXAMPLES=y
BR2_PACKAGE_RKADK_PLAYER=y
BR2_PACKAGE_RKWIFIBT_APP=y
BR2_PACKAGE_ROCKCHIP_RGA=y
BR2_PACKAGE_ROCKCHIP_TEST=y
BR2_PACKAGE_RSYNC=y
BR2_PACKAGE_SDL2=y
BR2_PACKAGE_SDL2_DIRECTFB=y
BR2_PACKAGE_SDL2_GFX=y
BR2_PACKAGE_SDL2_IMAGE=y
BR2_PACKAGE_SDL2_MIXER=y
BR2_PACKAGE_SDL2_SOUND_PLAYSOUND=y
BR2_PACKAGE_SDL2_TTF=y
BR2_PACKAGE_SDL_DIRECTFB=y
BR2_PACKAGE_SDL_GFX=y
BR2_PACKAGE_SDL_IMAGE=y
BR2_PACKAGE_SDL_IMAGE_GIF=y
BR2_PACKAGE_SDL_IMAGE_JPEG=y
BR2_PACKAGE_SDL_IMAGE_PNG=y
BR2_PACKAGE_SDL_IMAGE_TIFF=y
BR2_PACKAGE_SDL_SOUND=y
BR2_PACKAGE_SDL_TTF=y
BR2_PACKAGE_SED=y
BR2_PACKAGE_STRACE=y
BR2_PACKAGE_SUDO=y
BR2_PACKAGE_TCPDUMP=y
BR2_PACKAGE_TMUX=y
BR2_PACKAGE_USB_MODESWITCH=y
BR2_PACKAGE_UTIL_LINUX_AGETTY=y
BR2_PACKAGE_VIM=y
BR2_PACKAGE_WGET=y
BR2_PACKAGE_WPA_SUPPLICANT_PASSPHRASE=y
BR2_PACKAGE_WQY_ZENHEI=y
BR2_PACKAGE_ZSTD=y
# BR2_PREFER_ROCKCHIP_RGA is not set
BR2_ROCKCHIP_ALSA_CONFIG_INSTALL_INIT_SCRIPT=y
BR2_ROOTFS_OVERLAY+="board/rockchip/rk3506/fast-display-overlay/ board/rockchip/rk3506/luckfox-overlay/ board/rockchip/rk3506/picocalc-overlay/"
BR2_ROOTFS_POST_BUILD_SCRIPT+="board/rockchip/rk3506/post-build-fast-display.sh"
BR2_ROOTFS_PRE_BUILD_SCRIPT="board/rockchip/rk3506/build-picocalc-driver.sh"
BR2_SYSTEM_ENABLE_NLS=y
BR2_TARGET_GENERIC_HOSTNAME="luckfox"
BR2_TARGET_GENERIC_ISSUE="Welcome to Luckfox Lyra [root:luckfox]"
# BR2_TARGET_GENERIC_REMOUNT_ROOTFS_RW is not set
BR2_TARGET_GENERIC_ROOT_PASSWD="luckfox"
BR2_TARGET_ROOTFS_SQUASHFS4_ZSTD=y
BR2_TARGET_SERIAL_SHELL_GETTY=y
BR2_TIME_BITS_64=y
BR2_TOOLCHAIN_BUILDROOT_FORTRAN=y
BR2_arm=y
BR2_cortex_a7=y
```

## buildroot/package/extra-cmake-modules/Config.in.host
```kconfig
config BR2_PACKAGE_HOST_EXTRA_CMAKE_MODULES
	bool "host extra-cmake-modules"
        select BR2_PACKAGE_HOST_CMAKE
	help
	  This package corresponds to the extra CMake modules,

	  https://api.kde.org/frameworks/extra-cmake-modules/html/index.html
```

## buildroot/package/fcitx-tools/Config.in.host
```kconfig
config BR2_PACKAGE_HOST_FCITX_TOOLS
	bool "host fcitx-tools"
        select BR2_PACKAGE_HOST_EXTRA_CMAKE_MODULES
	help
          A Flexible Input Method Framework Build Tools

	  https://github.com/fcitx/fcitx
```
